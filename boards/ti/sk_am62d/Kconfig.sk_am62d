## boards/ti/sk_am62d/Kconfig.sk_am62d
```kconfig
# Copyright (C) 2023 BeagleBoard.org Foundation
# Copyright (C) 2023 S Prashanth
#
# SPDX-License-Identifier: Apache-2.0

config BOARD_SK_AM62D
	select SOC_AM62D_R5 if BOARD_SK_AM62D_AM62D_MAIN_R5F
```

## boards/ti/sk_am62d/sk_am62d_main_r5f_defconfig
```kconfig
CONFIG_XIP=n

# Enable Pinctrl
CONFIG_PINCTRL=y

# Serial Driver
CONFIG_SERIAL=y
CONFIG_UART_INTERRUPT_DRIVEN=y

# Enable Console
CONFIG_CONSOLE=y
CONFIG_UART_CONSOLE=y
```
